## board/rockchip/evb_px30/Kconfig
```kconfig
if TARGET_EVB_PX30

config RATTA_BOARD
	bool "Ratta project need board id"
	help
	  Ratta project open it.

config SYS_BOARD
	default "evb_px30"

config SYS_VENDOR
	default "rockchip"

config SYS_CONFIG_NAME
	default "evb_px30"

config BOARD_SPECIFIC_OPTIONS # dummy
	def_bool y

endif
```
